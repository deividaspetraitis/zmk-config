## config/boards/shields/think_corne/Kconfig.defconfig
```kconfig
# The Kconfig.defconfig file is where overrides for various configuration settings that make sense
# to have different defaults when this shield is used.
# One main item that usually has a new default value set here is the ZMK_KEYBOARD_NAME value,
# which controls the display name of the device over USB and BLE.
# The updated new default values should always be wrapped inside a conditional on the shield
# config name defined in the Kconfig.shield file.
#
# The side with the PS2 Mouse / TP has to be the central half

if SHIELD_THINK_CORNE_RIGHT

config ZMK_KEYBOARD_NAME
	default "ThinkCorne"

config ZMK_SPLIT_ROLE_CENTRAL
	default y

endif

if SHIELD_THINK_CORNE_LEFT || SHIELD_THINK_CORNE_RIGHT

config ZMK_SPLIT
	default y

endif
```

## config/boards/shields/think_corne/Kconfig.shield
```kconfig
# Copyright (c) 2020 Pete Johanson
# SPDX-License-Identifier: MIT

# The Kconfig.shield file defines any additional Kconfig settings that may be relevant when using this keyboard. 
# For most keyboards, there is just one additional configuration value for the shield itself.

config SHIELD_THINK_CORNE_LEFT
	def_bool $(shields_list_contains,think_corne_left)

config SHIELD_THINK_CORNE_RIGHT
	def_bool $(shields_list_contains,think_corne_right)
```
